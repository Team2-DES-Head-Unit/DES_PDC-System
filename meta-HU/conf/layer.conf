## meta-HU/conf/layer.conf
```bitbake
# We have a conf and classes directory, add to BBPATH
BBPATH .= ":${LAYERDIR}"

BBFILES += "${LAYERDIR}/recipes-*/*/*.bb \
            ${LAYERDIR}/recipes-*/*/*.bbappend \
            ${LAYERDIR}/recipes-*/*/*/*.bbappend \
	    "

BBFILE_COLLECTIONS += "HU"
BBFILE_PATTERN_HU = "^${LAYERDIR}/"
BBFILE_PRIORITY_HU = "11"
LAYERDEPENDS_HU = "core"
LAYERSERIES_COMPAT_HU = "kirkstone"
```

## meta-control/conf/layer.conf
```bitbake
# We have a conf and classes directory, add to BBPATH
BBPATH .= ":${LAYERDIR}"

BBFILES += "${LAYERDIR}/recipes-*/*/*.bb \
            ${LAYERDIR}/recipes-*/*/*.bbappend \
            ${LAYERDIR}/recipes-*/*/*/*.bbappend \
	    "

BBFILE_COLLECTIONS += "control"
BBFILE_PATTERN_control = "^${LAYERDIR}/"
BBFILE_PRIORITY_control = "11"
LAYERDEPENDS_control = "core"
LAYERSERIES_COMPAT_control = "kirkstone"
```

## meta-env/conf/layer.conf
```bitbake
# We have a conf and classes directory, add to BBPATH
BBPATH .= ":${LAYERDIR}"

BBFILES += "${LAYERDIR}/recipes-*/*/*.bb \
            ${LAYERDIR}/recipes-*/*/*.bbappend \
            ${LAYERDIR}/recipes-*/*/*/*.bbappend \
	    "

BBFILE_COLLECTIONS += "env"
BBFILE_PATTERN_env = "^${LAYERDIR}/"
BBFILE_PRIORITY_env = "11"
LAYERDEPENDS_env = "core"
LAYERSERIES_COMPAT_env = "kirkstone"
```

## meta-gui/conf/layer.conf
```bitbake
# We have a conf and classes directory, add to BBPATH
BBPATH .= ":${LAYERDIR}"

BBFILES += "${LAYERDIR}/recipes-*/*/*.bb \
            ${LAYERDIR}/recipes-*/*/*.bbappend \
            ${LAYERDIR}/recipes-*/*/*/*.bbappend \
	    "

BBFILE_COLLECTIONS += "gui"
BBFILE_PATTERN_gui = "^${LAYERDIR}/"
BBFILE_PRIORITY_gui = "11"
LAYERDEPENDS_gui = "core"
LAYERSERIES_COMPAT_gui = "kirkstone"
```
